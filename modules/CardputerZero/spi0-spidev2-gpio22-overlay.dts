/dts-v1/;
/plugin/;

/ {
    compatible = "brcm,bcm2835";

    fragment@0 {
        target = <&spi0>;
        __overlay__ {

            num-cs = <3>;
            cs-gpios = <&gpio 8 1>,
                        <&gpio 7 1>,
                        <&gpio 22 1>;
            spidev@2 {
                compatible = "spidev";
                reg = <2>;
                spi-max-frequency = <20000000>;
                status = "okay";
            };
        };
    };
};