/dts-v1/;
/plugin/;

/ {
    compatible = "brcm,bcm2835";

    fragment@0 {
        target = <&m5ioe1>;
        __overlay__ {

            always_high_pin: always-high {
                gpio-hog;
                gpios = <3 0>;
                output-high;
                line-name = "always-high-pin";
            };
        };
    };
};