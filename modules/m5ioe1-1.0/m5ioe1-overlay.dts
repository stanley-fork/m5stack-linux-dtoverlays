// Definitions for Waveshare WM8960 https://github.com/waveshare/WM8960-Audio-HAT
/dts-v1/;
/plugin/;
// dtc -@ -I dts -O dtb -o es8389-soundcard-overlay.dtbo  es8389-soundcard-overlay.dts
/ {
compatible = "brcm,bcm2835";

fragment@0 {
        target = <&i2c1>;
        __overlay__ {
                #address-cells = <1>;
                #size-cells = <0>;
                status = "okay";

                m5ioe1: gpio@6f {
                        compatible = "m5stack,m5ioe1";
                        reg = <0x6f>;
                        gpio-controller;
                        #gpio-cells = <2>;
                        ngpios = <16>;
                        #pwm-cells = <3>;
                        status = "okay";
                };
        };
};
};